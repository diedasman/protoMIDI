## firmware/config/boards/shields/protomidi/Kconfig.defconfig
```kconfig
if SHIELD_PROTOMIDI

config ZMK_KEYBOARD_NAME
    default "protoMIDI"

if ZMK_DISPLAY

config I2C
    default y

config SSD1306
    default y

choice ZMK_DISPLAY_STATUS_SCREEN
    default ZMK_DISPLAY_STATUS_SCREEN_CUSTOM
endchoice

config LV_Z_MEM_POOL_SIZE
    default 4096 if ZMK_DISPLAY_STATUS_SCREEN_CUSTOM

config PROTOMIDI_CUSTOM_STATUS_SCREEN
    bool
    default y if ZMK_DISPLAY_STATUS_SCREEN_CUSTOM
    select LV_USE_LABEL
    select LV_FONT_MONTSERRAT_16
    select LV_FONT_MONTSERRAT_12

endif # ZMK_DISPLAY

if LVGL

config LV_Z_VDB_SIZE
    default 64

config LV_DPI_DEF
    default 148

config LV_Z_BITS_PER_PIXEL
    default 1

choice LV_COLOR_DEPTH
    default LV_COLOR_DEPTH_1
endchoice

endif # LVGL

endif
```

## prototype/firmware/config/zephyr/Kconfig
```kconfig
config PROTOMIDI_CUSTOM_STATUS_SCREEN
    bool "protoMIDI custom OLED status screen"
    default y if SHIELD_PROTOMIDI && ZMK_DISPLAY_STATUS_SCREEN_CUSTOM
    depends on SHIELD_PROTOMIDI
```
